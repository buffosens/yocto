## build_example/conf/bblayers.conf
```bitbake
# POKY_BBLAYERS_CONF_VERSION is increased each time build/conf/bblayers.conf
# changes incompatibly
POKY_BBLAYERS_CONF_VERSION = "2"

BBPATH = "${TOPDIR}"
BBFILES ?= ""

BBLAYERS ?= " \
  /home/buffo/Projects/yocto/poky/meta \
  /home/buffo/Projects/yocto/poky/meta-poky \
  /home/buffo/Projects/yocto/poky/meta-yocto-bsp \
  /home/buffo/Projects/yocto/poky/meta-openembedded/meta-oe \
  /home/buffo/Projects/yocto/poky/meta-openembedded/meta-networking \
  /home/buffo/Projects/yocto/poky/meta-openembedded/meta-python \
  /home/buffo/Projects/yocto/poky/meta-openembedded/meta-multimedia \
  /home/buffo/Projects/yocto/poky/meta-atmel \
  /home/buffo/Projects/yocto/poky/meta-swarco \
  /home/buffo/Projects/yocto/poky/meta-mender/meta-mender-core \
  /home/buffo/Projects/yocto/poky/meta-mender/meta-mender-demo \
  "
```
